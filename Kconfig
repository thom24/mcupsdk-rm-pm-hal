## Kconfig
```kconfig
# PM and PM HAL configuration Main Kconfig
#
# For a description of the syntax of this configuration file,
# see https://www.kernel.org/doc/Documentation/kbuild/kconfig-language.txt
# NOTE: We ONLY support "bool"
#
# Copyright (C) 2020 Texas Instruments Incorporated - http://www.ti.com/
# ALL RIGHTS RESERVED
#

menu "RM & PM HAL Configuration"

# Memory organization

config ADDR_REMAP_OFFSET
	hex "Offset to apply when remapping MMR addresses"
	default 0x00000000
	help
	  Address offset to apply when remapping addresses for rd/wr accesses

config DM_BUILD
	bool "Build for a Device Manager configuration"
	default n if TIFS_BUILD
	default y
	help
	  Determine if RM & PM HAL are included as part of a Device Manager
	  build configuration

endmenu
```

## lpm/Kconfig
```kconfig
menu "Low Power Mode support"

config LPM_DM
	bool "Enable DM Low Power Mode support"
	help
	depends on LIBRARY_BUILD_DM
	 Enable required features in the DM to support low power modes.

config LPM_INCLUDE_OSAL
	bool "Enable OSAL support for LPM"
    help
    depends on LPM_DM
     Enable OSAL layer calls for LPM

config LPM_DM_STUB
	bool "Build an LPM Stub binary"
	depends on LPM_DM
	help
	 Enable Low Power Mode Stub Generation

config LNK_NSPS_BASE
	hex "LNK_NSPS base address"
	default 0x00040000
	depends on LPM_DM_STUB
	help
	  Default base address of Non-secure Preserved Storage Memory

config LNK_NSPS_LEN
	hex "Size of NSPS"
	default 0x00008000
	depends on LPM_DM_STUB
	help
	  Set the maximum size of Non-secure Preserved Storage Memory

config LPM_DM_TRACE
	bool "Enable LPM Debug Trace"
	depends on LPM_DM
	help
	 Enable Low Power Mode Debug Output over wakeup UART

endmenu
```

## pm/Kconfig
```kconfig
# Power Management configuration
#
# For a description of the syntax of this configuration file,
# see https://www.kernel.org/doc/Documentation/kbuild/kconfig-language.txt
# NOTE: We ONLY support "bool"
#
# Copyright (C) 2017 Texas Instruments Incorporated - http://www.ti.com/
# ALL RIGHTS RESERVED
#

menu "Power Management Feature support"

config PM
	bool "Power Management support"
	help
	 Enable Power management support

config PSC
	bool "PSC Controller support"
	depends on PM
	help
	 Enable support for PSC controller

config CLOCK
	bool "Enable support for clock"
	depends on PM
	help
	 Enable support for clocks

config CLK_RPLL028
	bool "Enable support rdpll028 PLL"
	depends on CLOCK
	help
	 Enable support rdpll028 PLL

config CLK_ADPLLM
	bool "Enable support for adpllm PLL"
	depends on CLOCK
	help
	 Enable support for adpllm PLL

config CLK_PLL_16FFT
	bool "Enable support for 16fft pllfrac2/pllfracf"
	depends on CLOCK
	help
	 Enable support for 16fft pllfrac2/pllfracf

config CLK_PLL_16FFT_FRACF_CALIBRATION
	bool "Enable support for 16fft pllfracf calibration"
	depends on CLK_PLL_16FFT
	default n if SOC_AM6
	default n if SOC_J721E
	help
	 Enable support for 16fft pllfracf calibration

config CLK_PLL_DESKEW
	bool "Enable support for 16fft deskew PLL"
	depends on CLOCK
	help
	 Enable support for 16fft deskew PLL

endmenu
```

## rm/Kconfig
```kconfig
# Resource Manager configuration
#
# For a description of the syntax of this configuration file,
# see https://www.kernel.org/doc/Documentation/kbuild/kconfig-language.txt
# NOTE: We ONLY support "bool"
#
# Copyright (C) 2017-2020 Texas Instruments Incorporated - http://www.ti.com/
# ALL RIGHTS RESERVED
#

menu "Resource Manager Feature Support"

config RM 
	bool "Enable Resource Manager"
	help
	 Enable support for Resource Manager functions

config RM_LOCAL_SUBSYSTEM_REQUESTS
	bool "Enable Resource Manager Local Subsystem Requests"
	depends on RM
	help
	 Enable support for Resource Manager using local subsystem calls for some services

config RM_IRQ
	bool "Enable IRQ support in Resource Manager"
	depends on RM
	help
	 Enable support for Resource Manager IRQ functions

config INTERRUPT_AGGREGATOR_UNMAPPED_EVENTS
	bool
	depends on RM_IRQ
	default n if SOC_AM6
	default n if SOC_J721E
	default y if SOC_AM64
	help
	 Enable Interrupt Aggregator unmapped event support

config RM_RA
	bool "Enable Ring Accelerator support in Resource Manager"
	depends on RM
	help
	 Enable support for Resource Manager Ring Accelerator functions

config RM_RA_DMSS_RING
	bool "Enable support for DMSS dual rings"
	depends on RM_RA
	default n if SOC_AM6
	default n if SOC_J721E
	default y if SOC_AM64
	help
	 Enable support for DMSS dual rings

config RM_RA_NAV_RING
	bool "Enable support for Navigator rings"
	depends on RM_RA
	default y if SOC_AM6
	default y if SOC_J721E
	default y if SOC_AM64
	help
	 Enable support for Navigator rings

config RM_UDMAP
	bool "Enable UDMAP support in Resource Manager"
	depends on RM
	help
	 Enable support for Resource Manager UDMAP functions

config UDMAP_CHANNEL_BURST_SIZE
	bool "Enable UDMAP Tx & Rx channel burst size configuration parameter"
	depends on RM_UDMAP
	default n if SOC_AM6
	help
	 Enable UDMAP Tx & Rx channel burst size configuration parameter

config UDMAP_TX_CHANNEL_TEARDOWN_TYPE
	bool "Enable UDMAP Tx channel teardown type configuration parameter"
	depends on RM_UDMAP
	default n if SOC_AM6
	help
	 Enable UDMAP Tx channel teardown type configuration parameter

config UDMAP_UDMA
	bool "Enable support for Navigator UDMAP channel types"
	depends on RM_UDMAP
	default y if SOC_AM6
	default y if SOC_J721E
	default n if SOC_AM64
	help
	 Enable support for Navigator UDMAP channel types

config UDMAP_BCDMA
	bool "Enable support for DMSS BCDMA channel types"
	depends on RM_UDMAP
	default n if SOC_AM6
	default n if SOC_J721E
	default y if SOC_AM64
	help
	 Enable support for DMSS BCDMA channel types

config UDMAP_PKTDMA
	bool "Enable support for DMSS PKTDMA channel types"
	depends on RM_UDMAP
	default n if SOC_AM6
	default n if SOC_J721E
	default y if SOC_AM64
	help
	 Enable support for DMSS PKTDMA channel types

config RM_PROXY
	bool "Enable Proxy support in Resource Manager"
	depends on RM
	help
	 Enable support for Resource Manager Proxy functions

endmenu
```

## rm/drivers/ia/Kconfig
```kconfig
# Resource Manager IA configuration
#
# For a description of the syntax of this configuration file,
# see https://www.kernel.org/doc/Documentation/kbuild/kconfig-language.txt
# NOTE: We ONLY support "bool"
#
# Copyright (C) 2020 Texas Instruments Incorporated - http://www.ti.com/
# ALL RIGHTS RESERVED
#

config INTERRUPT_AGGREGATOR_UNMAPPED_EVENTS
	bool
	depends on RM_IRQ
	default n if SOC_AM6
	default n if SOC_J721E
	help
	 Enable Interrupt Aggregator unmapped event support
```

## rm/drivers/irq/Kconfig
```kconfig
# Resource Manager IRQ configuration
#
# For a description of the syntax of this configuration file,
# see https://www.kernel.org/doc/Documentation/kbuild/kconfig-language.txt
# NOTE: We ONLY support "bool"
#
# Copyright (C) 2017-2020 Texas Instruments Incorporated - http://www.ti.com/
# ALL RIGHTS RESERVED
#

menu "Interrupt Management Feature Support"

config RM_IRQ 
	bool "Enable IRQ support in Resource Manager"
	depends on RM
	help
	 Enable support for Resource Manager IRQ functions

source "user/rm/drivers/ia/Kconfig"

endmenu
```

## rm/drivers/proxy/Kconfig
```kconfig
# Resource Manager Proxy configuration
#
# For a description of the syntax of this configuration file,
# see https://www.kernel.org/doc/Documentation/kbuild/kconfig-language.txt
# NOTE: We ONLY support "bool"
#
# Copyright (C) 2019 Texas Instruments Incorporated - http://www.ti.com/
# ALL RIGHTS RESERVED
#

config RM_PROXY
	bool "Enable Proxy support in Resource Manager"
	depends on RM
	help
	 Enable support for Resource Manager Proxy functions
```

## rm/drivers/psil/Kconfig
```kconfig
# Resource Manager PSI-L configuration
#
# For a description of the syntax of this configuration file,
# see https://www.kernel.org/doc/Documentation/kbuild/kconfig-language.txt
# NOTE: We ONLY support "bool"
#
# Copyright (C) 2018 Texas Instruments Incorporated - http://www.ti.com/
# ALL RIGHTS RESERVED
#

config RM_PSIL 
	bool "Enable PSIL support in Resource Manager"
	depends on RM
	help
	 Enable support for Resource Manager PSIL functions
```

## rm/drivers/ra/Kconfig
```kconfig
# Resource Manager Ring Accelerator configuration
#
# For a description of the syntax of this configuration file,
# see https://www.kernel.org/doc/Documentation/kbuild/kconfig-language.txt
# NOTE: We ONLY support "bool"
#
# Copyright (C) 2018-2020 Texas Instruments Incorporated - http://www.ti.com/
# ALL RIGHTS RESERVED
#

config RM_RA 
	bool "Enable Ring Accelerator support in Resource Manager"
	depends on RM
	help
	 Enable support for Resource Manager Ring Accelerator functions

config RM_RA_DMSS_RING
	bool "Enable support for DMSS dual rings"
	depends on RM_RA
	default n if SOC_AM6
	default n if SOC_J721E
	help
	 Enable support for DMSS dual rings

config RM_RA_NAV_RING
	bool "Enable support for Navigator rings"
	depends on RM_RA
	default y if SOC_AM6
	default y if SOC_J721E
	help
	 Enable support for Navigator rings
```

## rm/drivers/udmap/Kconfig
```kconfig
# Resource Manager UDMAP configuration
#
# For a description of the syntax of this configuration file,
# see https://www.kernel.org/doc/Documentation/kbuild/kconfig-language.txt
# NOTE: We ONLY support "bool"
#
# Copyright (C) 2018-2020 Texas Instruments Incorporated - http://www.ti.com/
# ALL RIGHTS RESERVED
#

config RM_UDMAP 
	bool "Enable UDMAP support in Resource Manager"
	depends on RM
	help
	 Enable support for Resource Manager UDMAP functions

config UDMAP_CHANNEL_BURST_SIZE
	bool "Enable UDMAP Tx & Rx channel burst size configuration parameter"
	depends on RM_UDMAP
	default n if SOC_AM6
	help
	 Enable UDMAP Tx & Rx channel burst size configuration parameter

config UDMAP_TX_CHANNEL_TEARDOWN_TYPE
	bool "Enable UDMAP Tx channel teardown type configuration parameter"
	depends on RM_UDMAP
	default n if SOC_AM6
	help
	 Enable UDMAP Tx channel teardown type configuration parameter

config UDMAP_UDMA
	bool "Enable support for Navigator UDMAP channel types"
	depends on RM_UDMAP
	default y if SOC_AM6
	default y if SOC_J721E
	help
	 Enable support for Navigator UDMAP channel types

config UDMAP_BCDMA
	bool "Enable support for DMSS BCDMA channel types"
	depends on RM_UDMAP
	default n if SOC_AM6
	default n if SOC_J721E
	help
	 Enable support for DMSS BCDMA channel types

config UDMAP_PKTDMA
	bool "Enable support for DMSS PKTDMA channel types"
	depends on RM_UDMAP
	default n if SOC_AM6
	default n if SOC_J721E
	help
	 Enable support for DMSS PKTDMA channel types
```
